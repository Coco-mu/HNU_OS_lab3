/dts-v1/;
/ {
    #address-cells = <2>;
    #size-cells = <1>;
    compatible = "linux,dummy-virt";
    model = "QEMU ARM virt";
    memory@40000000 { device_type = "memory"; reg = <0x0 0x40000000 0x10000000>; };
    uart@9000000 { compatible = "arm,pl011"; reg = <0x0 0x09000000 0x1000>; };
};
